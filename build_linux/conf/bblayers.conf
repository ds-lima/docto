## build_linux/conf/bblayers.conf
```bitbake
# POKY_BBLAYERS_CONF_VERSION is increased each time bui${TOPDIR}/../conf/bblayers.conf
# changes incompatibly
POKY_BBLAYERS_CONF_VERSION = "2"

BBPATH = "${TOPDIR}/"
BBFILES ?= ""

BBLAYERS ?= " \
  ${TOPDIR}/../poky/meta \
  ${TOPDIR}/../poky/meta-poky \
  ${TOPDIR}/../poky/meta-yocto-bsp \
  ${TOPDIR}/../meta-openembedded/meta-oe \
  ${TOPDIR}/../meta-openembedded/meta-python \
  ${TOPDIR}/../meta-openembedded/meta-perl \
  ${TOPDIR}/../meta-docto \
  ${TOPDIR}/../meta-secure-core/meta-secure-core-common \
  ${TOPDIR}/../meta-secure-core/meta-signing-key \
  ${TOPDIR}/../meta-secure-core/meta-tpm2 \
  ${TOPDIR}/../meta-secure-core/meta-efi-secure-boot \
  ${TOPDIR}/../meta-secure-core/meta-integrity \
  ${TOPDIR}/../meta-secure-core/meta-encrypted-storage \
"
```

## build_zephyr/conf/bblayers.conf
```bitbake
# POKY_BBLAYERS_CONF_VERSION is increased each time build/conf/bblayers.conf
# changes incompatibly
POKY_BBLAYERS_CONF_VERSION = "2"

BBPATH = "${TOPDIR}"
BBFILES ?= ""

BBLAYERS ?= " \
  /home/dioli/work/docto/poky/meta \
  /home/dioli/work/docto/poky/meta-poky \
  /home/dioli/work/docto/poky/meta-yocto-bsp \
  /home/dioli/work/docto/meta-openembedded/meta-oe \
  /home/dioli/work/docto/meta-openembedded/meta-python \
  /home/dioli/work/docto/meta-docto \
  /home/dioli/work/docto/meta-zephyr/meta-zephyr-bsp \
  /home/dioli/work/docto/meta-zephyr/meta-zephyr-core \
"
```

## meta-docto/conf/distro/docto.conf
```bitbake
DISTRO = "docto"
DISTRO_NAME = "docto (dslima yocto distro)"
DISTRO_VERSION = "1.0"

require conf/distro/poky.conf 

INIT_MANAGER = "systemd"
INITRAMFS_IMAGE = "secure-core-image-initramfs"
DISTRO_FEATURES_NATIVE:append = " ima tpm2 efi-secure-boot luks"
DISTRO_FEATURES:append = " ima tpm2 efi-secure-boot luks modsign"
MACHINE_FEATURES_NATIVE:append = " efi"
MACHINE_FEATURES:append = " efi"
PACKAGE_CLASSES = "package_rpm"
INHERIT += "sign_rpm_ext ima-evm-rootfs"
SECURE_CORE_IMAGE_EXTRA_INSTALL ?= "\
    packagegroup-efi-secure-boot \
    packagegroup-tpm2 \
    packagegroup-ima \
    packagegroup-luks \
"
#DEBUG_FLAGS:forcevariable = ""
IMAGE_INSTALL:append = " kernel-image-bzimage"

# Uncomment the following lines to disable SELoader
# and use gpg key to protect and verify files used by grub.
#UEFI_SELOADER ?= "0"
#GRUB_SIGN_VERIFY ?= "1"

# Uncomment this line to modify the root parameter in boot command line if the default one
# is not working for you. It is helpful when secure boot is enabled.
#BOOT_CMD_ROOT = "/dev/sda3"
```

## meta-docto/conf/layer.conf
```bitbake
# We have a conf and classes directory, add to BBPATH
BBPATH .= ":${LAYERDIR}"

# We have recipes-* directories, add to BBFILES
BBFILES += "${LAYERDIR}/recipes-*/*/*.bb \
            ${LAYERDIR}/recipes-*/*/*.bbappend"

BBFILE_COLLECTIONS += "meta-docto"
BBFILE_PATTERN_meta-docto = "^${LAYERDIR}/"
BBFILE_PRIORITY_meta-docto = "6"

LAYERDEPENDS_meta-docto = "core"
LAYERSERIES_COMPAT_meta-docto = "walnascar whinlatter"
```
